## raspberrypi/Config.in
```kconfig
source "$BR2_EXTERNAL_CDF_PATH/package/robotech/Config.in"
source "$BR2_EXTERNAL_CDF_PATH/package/cr1901/Config.in"
```

## raspberrypi/configs/cdfprincipal_defconfig
```kconfig
# From configs/raspberrypi3_defconfig

BR2_arm=y
BR2_cortex_a53=y
BR2_ARM_FPU_NEON_VFPV4=y

BR2_TOOLCHAIN_BUILDROOT_CXX=y

BR2_SYSTEM_DHCP="eth0"

# Linux headers same as kernel, a 4.9 series
BR2_PACKAGE_HOST_LINUX_HEADERS_CUSTOM_4_9=y

BR2_LINUX_KERNEL=y
BR2_LINUX_KERNEL_CUSTOM_GIT=y
BR2_LINUX_KERNEL_CUSTOM_REPO_URL="https://github.com/raspberrypi/linux.git"
BR2_LINUX_KERNEL_CUSTOM_REPO_VERSION="33ee56d5927ceff630fbc87e3f5caa409b6ae114"
BR2_LINUX_KERNEL_DEFCONFIG="bcm2709"

# Build the DTB from the kernel sources
BR2_LINUX_KERNEL_DTS_SUPPORT=y
BR2_LINUX_KERNEL_INTREE_DTS_NAME="bcm2710-rpi-3-b bcm2710-rpi-cm3"

BR2_PACKAGE_RPI_FIRMWARE=y

# Required tools to create the SD image
BR2_PACKAGE_HOST_DOSFSTOOLS=y
BR2_PACKAGE_HOST_GENIMAGE=y
BR2_PACKAGE_HOST_MTOOLS=y

# Filesystem / image
BR2_TARGET_ROOTFS_EXT2=y
BR2_TARGET_ROOTFS_EXT2_4=y
# BR2_TARGET_ROOTFS_TAR is not set
BR2_ROOTFS_POST_BUILD_SCRIPT="board/raspberrypi3/post-build.sh"
BR2_ROOTFS_POST_IMAGE_SCRIPT="board/raspberrypi3/post-image.sh"
BR2_ROOTFS_POST_SCRIPT_ARGS="--add-pi3-miniuart-bt-overlay"


# Custom

# Pour accélerer la compilation
BR2_TOOLCHAIN_EXTERNAL=y
BR2_CCACHE=y

# Pour faire joli
BR2_TARGET_GENERIC_HOSTNAME="principal"
BR2_TARGET_GENERIC_ISSUE="Robotech - CdF 2018 - Robot principal"

# Paquets nécessaires
BR2_PACKAGE_CHEF=y

# Fichiers supplémentaires
BR2_ROOTFS_OVERLAY="${BR2_EXTERNAL_CDF_PATH}/board/robotech/cdfprincipal/rootfs_overlay/"
BR2_ROOTFS_POST_BUILD_SCRIPT="${BR2_EXTERNAL_CDF_PATH}/board/robotech/cdfprincipal/post-build.sh board/raspberrypi3/post-build.sh"
BR2_ROOTFS_POST_IMAGE_SCRIPT="${BR2_EXTERNAL_CDF_PATH}/board/robotech/cdfprincipal/post-image.sh board/raspberrypi3/post-image.sh"
BR2_PACKAGE_BUSYBOX_CONFIG_FRAGMENT_FILES="${BR2_EXTERNAL_CDF_PATH}/board/robotech/cdfprincipal/busybox-extra.conf"
BR2_LINUX_KERNEL_CONFIG_FRAGMENT_FILES="${BR2_EXTERNAL_CDF_PATH}/board/robotech/cdfprincipal/linux-extra.conf"
# TODO Doesn't work

# On gère /etc/network/interfaces nous-même
BR2_SYSTEM_DHCP=""

# Pour le Wi-Fi
BR2_PACKAGE_LINUX_FIRMWARE=y
BR2_PACKAGE_LINUX_FIRMWARE_RTL_81XX=y # Clef Wi-Fi Geoffrey
BR2_PACKAGE_LINUX_FIRMWARE_BRCM_BCM43XXX=y # RPi3 Natif (cassé physiquement sur notre carte)
BR2_PACKAGE_WPA_SUPPLICANT=y

# Pour upgrader à chaud
BR2_PACKAGE_DROPBEAR=y
BR2_PACKAGE_RSYNC=y

# Pour faire plaisir à Geoffrey
BR2_PACKAGE_HTOP=y

# Pour debugguer
BR2_PACKAGE_GDB=y

# Pour uploader sur le Arduino
BR2_TOOLCHAIN_BUILDROOT_WCHAR=y
BR2_SHARED_LIBS=y
BR2_PACKAGE_UCLIBC=y
BR2_PACKAGE_AVRDUDE=y

# Pour uploader sur le FPGA
BR2_PACKAGE_MERCPCL=y

# Communication I2C
BR2_PACKAGE_BUSYBOX_SHOW_OTHERS=y
BR2_PACKAGE_I2C_TOOLS=y

# Augmentation de la capacité
BR2_TARGET_ROOTFS_EXT2_SIZE="128M"
```

## raspberrypi/package/cr1901/mercpcl/Config.in
```kconfig
config BR2_PACKAGE_MERCPCL
    bool "mercpcl"
    select BR2_PACKAGE_LIBUSB
    select BR2_PACKAGE_LIBFTDI
    help
        Command-line utility that can be used to program
        Mercury FPGA development boards.
```

## raspberrypi/package/robotech/chef/Config.in
```kconfig
config BR2_PACKAGE_CHEF
    bool "chef"
    select BR2_PACKAGE_WIRINGPI
    help
        Cerveau du robot principal pour la Coupe de France
        de Robotique, équipe Robotech Lille (Polytech Lille).
```
